## drivers/i2c/Kconfig.thejas32
```kconfig
# Copyright (c) 2026 Anuj Deshpande
# SPDX-License-Identifier: Apache-2.0

config I2C_THEJAS32
	bool "C-DAC THEJAS32 I2C driver"
	default y
	depends on DT_HAS_CDAC_THEJAS32_I2C_ENABLED
	help
	  Enable the I2C driver for the C-DAC THEJAS32 SoC.
```

## drivers/pwm/Kconfig.thejas32
```kconfig
# Copyright (c) 2026 Anuj Deshpande
# SPDX-License-Identifier: Apache-2.0

config PWM_THEJAS32
	bool "C-DAC THEJAS32 PWM driver"
	default y
	depends on DT_HAS_CDAC_THEJAS32_PWM_ENABLED
	help
	  Enable the PWM driver for the C-DAC THEJAS32 SoC.
```

## drivers/spi/Kconfig.thejas32
```kconfig
# Copyright (c) 2026 Anuj Deshpande
# SPDX-License-Identifier: Apache-2.0

config SPI_THEJAS32
	bool "C-DAC THEJAS32 SPI driver"
	default y
	depends on DT_HAS_CDAC_THEJAS32_SPI_ENABLED
	help
	  Enable the SPI driver for the C-DAC THEJAS32 SoC.
```

## dts/bindings/i2c/cdac,thejas32-i2c.yaml
```yaml
# Copyright (c) 2026 Anuj Deshpande
# SPDX-License-Identifier: Apache-2.0

description: C-DAC THEJAS32 I2C controller

compatible: "cdac,thejas32-i2c"

include: i2c-controller.yaml

properties:
  reg:
    required: true

  input-clock-frequency:
    type: int
    required: true
    description: Frequency of the clock feeding the controller, in Hz.
```

## dts/bindings/pwm/cdac,thejas32-pwm.yaml
```yaml
# Copyright (c) 2026 Anuj Deshpande
# SPDX-License-Identifier: Apache-2.0

description: C-DAC THEJAS32 PWM controller

compatible: "cdac,thejas32-pwm"

include: [pwm-controller.yaml, base.yaml]

properties:
  reg:
    required: true

  clock-frequency:
    type: int
    required: true
    description: Frequency of the clock feeding the controller, in Hz.

  "#pwm-cells":
    const: 3

pwm-cells:
  - channel
  - period
  - flags
```

## dts/bindings/spi/cdac,thejas32-spi.yaml
```yaml
# Copyright (c) 2026 Anuj Deshpande
# SPDX-License-Identifier: Apache-2.0

description: C-DAC THEJAS32 SPI controller

compatible: "cdac,thejas32-spi"

include: spi-controller.yaml

properties:
  reg:
    required: true

  clock-frequency:
    type: int
    required: true
    description: Frequency of the clock feeding the controller, in Hz.
```
